## meta-demo/conf/layer.conf
```bitbake
# We have a conf and classes directory, append to BBPATH
BBPATH .= ":${LAYERDIR}"

# We have a recipes directory, add to BBFILES
BBFILES += "${LAYERDIR}/recipes-*/*.bb ${LAYERDIR}/recipes-*/*.bbappend"
BBFILES += "${LAYERDIR}/recipes-*/*/*.bb ${LAYERDIR}/recipes-*/*/*.bbappend"

BBFILE_COLLECTIONS += "gemdemo"
BBFILE_PATTERN_gemdemo := "^${LAYERDIR}/"
BBFILE_PRIORITY_gemdemo = "7"

LAYERVERSION_gemdemo = "1"
```

## meta-gl/conf/layer.conf
```bitbake
# We have a conf and classes directory, append to BBPATH
BBPATH .= ":${LAYERDIR}"

# We have a recipes directory, add to BBFILES
BBFILES += "${LAYERDIR}/recipes-*/*.bb ${LAYERDIR}/recipes-*/*.bbappend"
BBFILES += "${LAYERDIR}/recipes-*/*/*.bb ${LAYERDIR}/recipes-*/*/*.bbappend"

BBFILE_COLLECTIONS += "mozrust"
BBFILE_PATTERN_mozgldevel := "^${LAYERDIR}/"
BBFILE_PRIORITY_mogldevel = "7"

LAYERVERSION_mozgldevel = "1"
```

## meta-oe-warrior/conf/layer.conf
```bitbake
# We have a conf and classes directory, append to BBPATH
BBPATH .= ":${LAYERDIR}"

# We have a recipes directory, add to BBFILES
BBFILES += "${LAYERDIR}/recipes-*/*.bb ${LAYERDIR}/recipes-*/*.bbappend"
BBFILES += "${LAYERDIR}/recipes-*/*/*.bb ${LAYERDIR}/recipes-*/*/*.bbappend"

BBFILE_COLLECTIONS += "mozoedevel"
BBFILE_PATTERN_mozoedevel := "^${LAYERDIR}/"
BBFILE_PRIORITY_mooedevel = "7"

LAYERSERIES_COMPAT_mozoedevel = " rocko warrior "

LAYERVERSION_mozoedevel = "1"
```

## meta-poky-rust/conf/layer.conf
```bitbake
# We have a conf and classes directory, append to BBPATH
BBPATH .= ":${LAYERDIR}"

# We have a recipes directory, add to BBFILES
BBFILES += "${LAYERDIR}/recipes-*/*.bb ${LAYERDIR}/recipes-*/*.bbappend"
BBFILES += "${LAYERDIR}/recipes-*/*/*.bb ${LAYERDIR}/recipes-*/*/*.bbappend"

BBFILE_COLLECTIONS += "mozrust"
BBFILE_PATTERN_mozrust := "^${LAYERDIR}/"
BBFILE_PRIORITY_mozrust = "7"

LAYERVERSION_mozrust = "1"
```

## meta-webkit/conf/layer.conf
```bitbake
# We have a conf and classes directory, append to BBPATH
BBPATH .= ":${LAYERDIR}"

# We have a recipes directory, add to BBFILES
BBFILES += "${LAYERDIR}/recipes-*/*.bb ${LAYERDIR}/recipes-*/*.bbappend"
BBFILES += "${LAYERDIR}/recipes-*/*/*.bb ${LAYERDIR}/recipes-*/*/*.bbappend"

BBFILE_COLLECTIONS += "mozwebkit"
BBFILE_PATTERN_mozwebkit := "^${LAYERDIR}/"
BBFILE_PRIORITY_mozwebkit = "7"

LAYERVERSION_mozwebkit = "1"
```
